## drivers/soc/samsung/Kconfig
```kconfig
# SPDX-License-Identifier: GPL-2.0
#
# SAMSUNG SoC drivers
#
menuconfig SOC_SAMSUNG
	bool "Samsung SoC driver support" if COMPILE_TEST

if SOC_SAMSUNG

config EXYNOS_PMU
	bool "Exynos Power Management Unit Driver Support"
	depends on ARCH_EXYNOS
	select MFD_SYSCON

config EXYNOS_PM_DOMAINS
	bool "Exynos PM domains" if COMPILE_TEST
	depends on PM_GENERIC_DOMAINS || COMPILE_TEST

source "drivers/soc/samsung/acpm/Kconfig"
config EXYNOS_CHIPID
	bool "Exynos Chipid controller driver"
	depends on ARCH_EXYNOS
	select SOC_BUS

config USI
	bool "Enable Universal Serial Interface"
	default n

config USI_V2
	bool "Enable Universal Serial Interface version 2"
	default y

config ECT
	bool "Enable Exynos Characteristic Table File"
	default n
	depends on ARCH_EXYNOS

config ECT_DUMP
	bool "Enable Exynos Characteristic Table File Dump sysfs"
	default n
	depends on ECT

config EXYNOS_PD
	bool "Exynos PM domain Support"
	depends on ARCH_EXYNOS
	depends on PM
	select PM_GENERIC_DOMAINS

config EXYNOS_CPUPM
	bool "Exynos CPU Power Management driver"
	depends on ARCH_EXYNOS && EXYNOS_PMU && PMUCAL
	help
	Support Exynos CPU Power Control for EXYNOS SoC.

config EXYNOS_RGT
	bool "Exynos Regulator Debug Support"
	depends on REGULATOR
	depends on DEBUG_FS
	depends on OF
	help
	  dummy device driver for debugging samsung PMIC

config EXYNOS_BCM
	bool "EXYNOS_BCM driver support"
	default n
	help
	  Enable exynos_bcm driver support

config CAL_IF
	bool "Exynos Chip Abstraction Layer Interface"
	help
	  Support CMU CAL for Exynos SoC.

config EXYNOS_PM_DVS
       bool "Enable Exynos dynamic voltage setting"
       default n

config PMUCAL
	bool "Exynos PMU Chip Abstraction Layer"
	depends on CAL_IF
	default y
	help
	 Support PMUCAL for Exynos SoC.

config CHUB_PMUCAL
        bool "Exynos PMU(for SHUB) Chip Abstraction Layer"
        default n
        depends on CAL_IF
        help
        Support CHUB_PMUCAL for Exynos SoC.

config FLEXPMU
	bool "Exynos FLEXPMU"
	depends on PMUCAL
	default n
	help
	 Support PMUCAL for Exynos SoC.

config EXYNOS_FLEXPMU_DBG
	bool "Exynos FLEXPMU DBG"
	depends on FLEXPMU
	default y
	help
	 Support FLEXPMU for Exynos SoC.

config CMUCAL
	bool "Exynos CMU Chip Abstraction Layer"
	depends on CAL_IF
	default y
	help
	  Support CMUCAL for Exynos SoC.
config CP_PMUCAL
	bool "Exynos PMU(for CP) Chip Abstraction Layer"
	depends on CAL_IF
	help
	Support CP_PMUCAL for Exynos SoC.

config GNSS_PMUCAL
	bool "Exynos PMU(for GNSS) Chip Abstraction Layer"
	depends on CAL_IF
	help
	  Support GNSS_PMUCAL for Exynos SoC.

config CMUCAL_DEBUG
	bool "CMUCAL Debug Interface"
	depends on CMUCAL

config CMUCAL_QCH_IGNORE_SUPPORT
	bool "CMUCAL QCH IGNORE Support"
	depends on CMUCAL

config ACPM_DVFS
	bool "Exynos ACPM DVFS manager"
	depends on CAL_IF && CMUCAL
	default y
	help
	  Support ACPM DVFS for Exynos SoC.

source "drivers/soc/samsung/cpif/Kconfig"
source "drivers/soc/samsung/gnssif/Kconfig"

config EXYNOS_DVFS_MANAGER
	bool "Exynos DVFS Manager"
	default n
	depends on ARCH_EXYNOS
	help
	  Enable DVFS Manager for Exynos SoC.
	  This module controls constraint between each DVFS domains.

config EXYNOS_SDM
	tristate "Exynos Security Dump Manager Support"
	depends on DEBUG_SNAPSHOT
	default y
	help
	  Exynos Security Dump Manager

source "drivers/soc/samsung/debug/Kconfig"
endif
```
