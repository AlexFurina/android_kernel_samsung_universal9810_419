## drivers/bts/Kconfig
```kconfig
#
# BTS device driver Kernel Configuration
#

menuconfig EXYNOS_BTS
	bool "BTS device driver support"
	help
	  Enables BTS(Bus Traffic Shaper) device driver support
	  BTS device driver will set BTS and request DVFS for
	  controlling system bus traffic. Default setting of BTS
	  should be different to chipset because of hardware characteristics.

if EXYNOS_BTS

config EXYNOS9110_BTS
        bool "Bus traffic shaper support for exynos3830"
        default y
        depends on SOC_EXYNOS9110
        help
          Enable BTS (Bus traffic shaper) support for exynos9110

config EXYNOS9810_BTS
	bool "Bus traffic shaper support for exynos9810"
	default y
	depends on SOC_EXYNOS9810
	help
          Enable BTS (Bus traffic shaper) support for exynos9810
endif
```

## drivers/soc/samsung/debug/Kconfig
```kconfig
menuconfig EXYNOS_DEBUG
        bool "Exynos Debug Features"
        default n

if EXYNOS_DEBUG
menuconfig DEBUG_SNAPSHOT
	tristate "Debug SnapShot Support"
	depends on EXYNOS_DEBUG
	default n

config DEBUG_SNAPSHOT_CRASH_KEY
	bool "Support Crash Key to artificial panic for debugging"
	depends on DEBUG_SNAPSHOT
	default n

config DEBUG_SNAPSHOT_FREQ_DOMAIN_NUM
	int "Number of freq logging domain type"
	depends on DEBUG_SNAPSHOT
	range 4 32
	default 32

config DEBUG_SNAPSHOT_LOG_ITEM_SIZE
	int "Number of logging item base size"
	depends on DEBUG_SNAPSHOT
	range 256 1024
	default 1024

config DEBUG_SNAPSHOT_SFRDUMP
	tristate "Debug Snapshot SFRDUMP"
	depends on DEBUG_SNAPSHOT
	default n

config DEBUG_SNAPSHOT_QUICKDUMP
	tristate "Debug Snapshot quickdump"
	depends on DEBUG_SNAPSHOT
	default n

config DEBUG_SNAPSHOT_DPM
    tristate "Debug Snapshot DPM"
    depends on DEBUG_SNAPSHOT
    default n

config EXYNOS_ITMON
        bool "Exynos IPs Traffic Monitor"
        depends on EXYNOS_DEBUG

config EXYNOS_DEBUG_TEST
        tristate "Exynos debug feature test"
        depends on DEBUG_SNAPSHOT
        default n
endif
```

## drivers/video/fbdev/exynos/Kconfig
```kconfig
if SOC_EXYNOS9110|| SOC_EXYNOS3830

source "drivers/video/fbdev/exynos/dpu30/Kconfig"

endif # SOC_EXYNOS9110|| SOC_EXYNOS3830

if SOC_EXYNOS9810

source "drivers/video/fbdev/exynos/dpu_9810/Kconfig"

endif # SOC_EXYNOS9810
```
